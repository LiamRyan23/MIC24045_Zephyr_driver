## drivers/regulator/mic24045/Kconfig
```kconfig
# Configuration options

config REGULATOR_MIC24045
    bool "MIC24045 I2C Buck Regulator"
    depends on REGULATOR
    select I2C
    help
      Enable support for the Microchip MIC24045 regulator.

config REGULATOR_MIC24045_INIT_PRIORITY
    int "MIC24045 regulator init priority"
    depends on REGULATOR_MIC24045
    default 85
    help
      Init priority for the MIC24045 regulator driver. It must be
      greater than I2C_INIT_PRIORITY.
```
